## firmware/zmk-shield/Kconfig.defconfig
```kconfig
# SPDX-License-Identifier: MIT

if SHIELD_CUBICHNIA_RIGHT
	config ZMK_KEYBOARD_NAME
		default "Cubichnia"
	config ZMK_SPLIT_BLE_ROLE_CENTRAL
		default y
endif

if SHIELD_CUBICHNIA_LEFT
	config ZMK_KEYBOARD_NAME
		default "Cubichnia*"
endif

if SHIELD_CUBICHNIA_LEFT || SHIELD_CUBICHNIA_RIGHT
	config ZMK_SPLIT
		default y
endif
```

## firmware/zmk-shield/Kconfig.shield
```kconfig
# SPDX-License-Identifier: MIT

config SHIELD_CUBICHNIA_LEFT
	def_bool $(shields_list_contains,cubichnia_left)

config SHIELD_CUBICHNIA_RIGHT
	def_bool $(shields_list_contains,cubichnia_right)
```
